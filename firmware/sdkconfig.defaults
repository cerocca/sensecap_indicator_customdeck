## firmware/sdkconfig.defaults
```kconfig
# Base da indicator_ha/sdkconfig.defaults (stesso hardware)
CONFIG_IDF_TARGET="esp32s3"

CONFIG_IDF_EXPERIMENTAL_FEATURES=y

CONFIG_SPIRAM=y
CONFIG_SPIRAM_SPEED_120M=y
CONFIG_SPIRAM_MODE_OCT=y
# Fix InstrFetchProhibited: mappa .text/.rodata su PSRAM via MMU.
# Quando Wi-Fi sospende la cache Flash (accesso NVS/calibrazione), il codice
# continua a girare da PSRAM → nessun crash nell'idle hook o nelle ISR.
# Richiede IDF_EXPERIMENTAL_FEATURES=y e SPIRAM_MODE_OCT=y (entrambi già attivi).
CONFIG_SPIRAM_XIP_FROM_PSRAM=y
# Disabilita MEMPROT: con XIP_FROM_PSRAM il boundary IRAM/PSRAM è gestito dal
# cache MMU — MEMPROT aggiunge un secondo layer che può causare falsi positivi.
CONFIG_ESP_SYSTEM_MEMPROT_FEATURE=n

CONFIG_COMPILER_OPTIMIZATION_PERF=y
CONFIG_ESP_DEFAULT_CPU_FREQ_MHZ_240=y

CONFIG_ESPTOOLPY_FLASHMODE_QIO=y
CONFIG_ESPTOOLPY_FLASHFREQ_120M=y
CONFIG_ESPTOOLPY_FLASHSIZE_8MB=y

CONFIG_PARTITION_TABLE_CUSTOM=y
CONFIG_PARTITION_TABLE_CUSTOM_FILENAME="partitions.csv"
CONFIG_PARTITION_TABLE_FILENAME="partitions.csv"
CONFIG_PARTITION_TABLE_OFFSET=0x8000

CONFIG_FREERTOS_HZ=1000
# Disabilita Wi-Fi power management in STA disconnected: previene crash in esp_phy_enable/ppTask.
CONFIG_ESP_WIFI_STA_DISCONNECTED_PM_ENABLE=n
CONFIG_ESP_MAIN_TASK_STACK_SIZE=16384

CONFIG_LCD_AVOID_TEAR=y
CONFIG_LCD_LVGL_DIRECT_MODE=y
CONFIG_LCD_TASK_REFRESH_TIME=10
CONFIG_LCD_RGB_ISR_IRAM_SAFE=y
CONFIG_LCD_RGB_RESTART_IN_VSYNC=y

CONFIG_LV_MEM_CUSTOM=y
CONFIG_LV_TXT_ENC_UTF8=y
CONFIG_LV_FONT_DEFAULT_MONTSERRAT_14=y
CONFIG_LV_FONT_MONTSERRAT_12=y
CONFIG_LV_FONT_MONTSERRAT_14=y
CONFIG_LV_FONT_MONTSERRAT_16=y
CONFIG_LV_FONT_MONTSERRAT_18=y
CONFIG_LV_FONT_MONTSERRAT_20=y

# UART TX ISR in IRAM: previene blocco uart_tx_char quando Wi-Fi sospende la cache Flash.
# Stesso pattern di SPIRAM_XIP_FROM_PSRAM — ISR deve essere accessibile senza flash.
CONFIG_UART_ISR_IN_IRAM=y

CONFIG_MBEDTLS_EXTERNAL_MEM_ALLOC=y
CONFIG_MBEDTLS_DYNAMIC_BUFFER=y
CONFIG_MBEDTLS_DYNAMIC_RX_BUFFER=y
CONFIG_MBEDTLS_DYNAMIC_TX_BUFFER=y

CONFIG_ESP_TLS_INSECURE=y
CONFIG_ESP_TLS_SKIP_SERVER_CERT_VERIFY=y
```
